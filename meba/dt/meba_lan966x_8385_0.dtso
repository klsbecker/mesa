// Copyright (c) 2004-2020 Microchip Technology Inc. and its subsidiaries.
// SPDX-License-Identifier: MIT

/dts-v1/;
/plugin/;

/ {
        fragment@0 {
		target-path = "/";
		__overlay__ {
			meba {
				board = "EVB-LAN9668-EDS";
				type = "0";
				board_port_cnt = "8";
				target = "0x9668";
				pcb = "0x8385";
			};
		};
	};
};
